## drivers/media/video/sii8246/Kconfig
```kconfig
#
# mhl drivers configuration
#

menuconfig SAMSUNG_MHL
	tristate "MHL driver support"
	help
          If you want to use MHL driver,
          enable this option and other options below.

if SAMSUNG_MHL

comment "silicon image MHL trasmitter"
 
config SAMSUNG_MHL_8246
        bool "Enable Sii8246 MHL Chip Driver"
	depends on SAMSUNG_MHL
        default n
        ---help---
          support Sii8246 MHL Chip Driver	  

config MHL_HPD_SYNC_WA
        bool "Enable MHL-HDMI HPD synchronization code"
	depends on SAMSUNG_MHL
        default n

config SAMSUNG_USE_11PIN_CONNECTOR
	bool "11pin micro-usb connector support"
	default n
	---help---
	  use 11pin micro usb connector instead of 5pin

config SAMSUNG_SMARTDOCK
	bool "smartdock support"
	default n

endif #SAMSUNG_MHL
```
